## latest_builds/firmware_source/app/boards/anticipy/anticipy_e1/Kconfig
```kconfig
if BOARD_ANTICIPY_E1
config BOARD_ENABLE_DCDC
	bool "MDBT50Q internal REG1 DCDC"
	select SOC_DCDC_NRF52X
	default y
endif
```

## latest_builds/firmware_source/app/boards/anticipy/anticipy_e1/board.yml
```yaml
board:
  name: anticipy_e1
  vendor: anticipation_labs
  socs:
    - name: nrf52840
```
